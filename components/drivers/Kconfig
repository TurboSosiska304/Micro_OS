## components/drivers/Kconfig
```kconfig
menu "Micro OS drivers"

config MICRO_OS_MIC
    bool "SPM1423 microphone on I2S (PDM)"
    default y
    help
      The microphone of the StickC Plus2: an SPM1423 MEMS element with a
      PDM output, clocked on G0 and sampled on G34 by the I2S peripheral.
      The hardware doctor listens to a short window at every boot and
      reports the level it hears, and the shell command "mic" shows the
      level of one window. Turning this off gives the I2S channel and its
      DMA buffers back to an application that needs them.

config MICRO_OS_BUZZER_BEEP_ON_CHECK
    bool "Beep at boot to prove that the buzzer works"
    default n
    help
      The hardware doctor sounds the buzzer for 30 ms at every boot,
      so that the buzzer and its LEDC timer can be heard working.
      The check itself does not need the sound - the state of the
      module is the same either way - so the beep is off by default
      and this switch brings it back.

endmenu
```

## components/fs_ext2/Kconfig
```kconfig
config MICRO_OS_FS_EXT2
    bool "ext2, read and written"
    default n
    help
        Read and write an ext2 volume: the superblock, the group
        descriptors, the inode table, the direct and the indirect blocks,
        the directories, the bitmaps of the groups. A file is created,
        written, cut and removed, a directory is made, and the mode and
        the owner change. A record of ext2 keeps a mode, an owner and the
        moments of a change, so stat, statx and ls -l answer with what the
        medium holds.
```

## components/fs_fat32/Kconfig
```kconfig
menu "Micro OS filesystems"

    config MICRO_OS_FS_FAT32
        bool "FAT12/16/32, read and write"
        default n
        help
            Read and write the volume of a card or a disk that another
            system made. The filesystem has no modes, no owners and no
            time of its own: stat answers zero for the first two, and
            chmod and chown are not supported. There is no journal, so a
            power cut in the middle of a change is a volume a checker has
            to look at.

endmenu
```

## components/net/Kconfig
```kconfig
menu "Micro OS network"

    config MICRO_OS_NET
        bool "the network services of the board"
        default y
        help
            The HTTP client, the clock from NTP, the page of the state and
            the MQTT client. The sockets come from the port; the protocols
            are portable and are tested on the host. Turn this off for an
            image that has no network at all: no source of the component is
            compiled and no command of it is registered.

    config MICRO_OS_NET_HTTP
        bool "the HTTP client and the http command"
        depends on MICRO_OS_NET
        default y
        help
            GET a URL and print the status and the body: the command
            "http get <url>", and the transport the page of the state uses.

    config MICRO_OS_NET_HTTP_SERVER
        bool "the page of the state (httpd)"
        depends on MICRO_OS_NET
        default n
        help
            The page on port 80 that a person starts with "httpd". It is off
            by default: a command a person starts is a feature of the
            session, not of the boot, and the listener task costs the static
            memory of the board.

    config MICRO_OS_NET_NTP
        bool "the clock from NTP and the ntp command"
        depends on MICRO_OS_NET
        default y
        help
            Ask an NTP server for the time of Unix and give it to the clock
            of the board. A board without a network to a time server can
            leave it out.

    config MICRO_OS_NET_MQTT
        bool "the MQTT client and the mqtt command"
        depends on MICRO_OS_NET
        default n
        help
            Publish one message over MQTT 3.1.1. Off by default: the board
            has no broker of its own, and a release that wants the client
            turns it on in sdkconfig.defaults (ADR 0010).

endmenu
```

## components/port_esp32/Kconfig
```kconfig
menu "Micro OS image"

    config MICRO_OS_REQUIRE_SIGNATURE
        bool "refuse an image without a valid signature"
        default y
        help
            The application checks the trailer of its own factory partition
            (MOSIGN01, SHA-256 and Ed25519) at the beginning of app_main,
            before the filesystem and the shell. On, an image without a valid
            trailer prints the reason and stops the boot; off, the check is
            still made and the line
            "unsigned or damaged image: not guaranteed" goes to the console,
            and the board continues. The check is electronic: the ROM and the
            ESP-IDF bootloader have already loaded the application, so a
            damaged image may have run its first instructions before the
            sentence appears. The board bundle is signed by tools/bundle.sh,
            and the public key is compiled into the firmware.

    config MICRO_OS_ANTIROLLBACK
        bool "refuse an image older than the version stored in the NVS"
        default n
        help
            The version of the image comes from esp_app_desc_t.version. The
            boot keeps the newest version it has seen in the NVS and refuses
            a lower one (prints the two versions and stops) when this flag is
            on; with the flag off a rollback is a warning. The minimum is
            updated after a signature that passed. The store is the NVS of
            the board, not /etc: the check runs before the filesystem is
            mounted. This is not the secure-boot anti-rollback of the eFuses
            and it does not protect the NVS from a person who can flash the
            board.

endmenu
```

## components/telnet/Kconfig
```kconfig
menu "Micro OS telnet"

    config MICRO_OS_TELNET
        bool "the shell on TCP port 23"
        default y
        help
            The telnet server and the commands of the session: the same
            shell the UART and the display show, on the local network. There
            is no authentication, and "telnet off" closes the door. A build
            that leaves it out keeps the shell itself.

endmenu
```

## components/wifi/Kconfig
```kconfig
menu "Micro OS WiFi"

    config MICRO_OS_WIFI
        bool "the WiFi station"
        default y
        help
            The portable core of the station, the radio of the port and the
            driver that registers the module and the command. A build
            without a network turns this off and links none of the three:
            the ESP-IDF WiFi stack is not asked for either.

endmenu
```
